## Kconfig
```kconfig
#
# (C) Copyright 2020
# Zimplistic Private Limited
# Sicris Rey Embay, sicris@zimplistic.com
#
# For a description of syntax, see
# https://www.kernel.org/doc/Documentation/kbuild/kconfig-language.txt
#
mainmenu "Test Configuration"

menu "Test Configuration"
    choice
        prompt "Foo-bar choice"
        config FOO
            bool "Foo"
        config BAR
            bool "Bar"
    endchoice
endmenu
```
